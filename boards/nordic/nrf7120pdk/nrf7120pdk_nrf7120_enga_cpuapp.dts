/*
 * Copyright (c) 2024 Nordic Semiconductor ASA
 *
 * SPDX-License-Identifier: Apache-2.0
 */

/dts-v1/;

#include "nrf7120_enga_cpuapp_common.dtsi"

/ {
	compatible = "nordic,nrf7120pdk_nrf7120_enga-cpuapp";
	model = "Nordic nRF7120 PDK nRF7120_EGNA Application MCU";

	chosen {
		zephyr,sram = &cpuapp_sram;
	};
};
