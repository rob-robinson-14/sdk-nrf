## boards/nordic/nrf7120pdk/Kconfig.defconfig
```kconfig
# Copyright (c) 2024 Nordic Semiconductor ASA
# SPDX-License-Identifier: Apache-2.0
if BOARD_NRF7120PDK_NRF7120_ENGA_CPUAPP
config BT_CTLR
	default BT
endif # BOARD_NRF7120PDK_NRF7120_ENGA_CPUAPP
if BOARD_NRF7120PDK_NRF7120_ENGA_CPUFLPR || BOARD_NRF7120PDK_NRF7120_ENGA_CPUFLPR_XIP
# As FLPR has limited memory most of tests does not fit with asserts enabled.
config ASSERT
	default n if ZTEST
endif # BOARD_NRF7120PDK_NRF7120_ENGA_CPUFLPR || BOARD_NRF7120PDK_NRF7120_ENGA_CPUFLPR_XIP
```

## boards/nordic/nrf7120pdk/Kconfig.nrf7120pdk
```kconfig
# Copyright (c) 2025 Nordic Semiconductor ASA
# SPDX-License-Identifier: LicenseRef-Nordic-5-Clause

config BOARD_NRF7120PDK
	select SOC_NRF7120_ENGA_CPUAPP if BOARD_NRF7120PDK_NRF7120_CPUAPP_EMU
	select SOC_NRF7120_PREENG if BOARD_NRF7120PDK_NRF7120_CPUAPP_EMU
	select BOARD_EARLY_INIT_HOOK
```

## boards/nordic/nrf7120pdk/board.yml
```yaml
board:
  name: nrf7120pdk
  full_name: nRF7120 DK
  vendor: nordic
  socs:
  - name: nrf7120
    variants:
    - name: emu
      cpucluster: cpuapp
    - name: fpga
      cpucluster: cpuapp
```

## dts/bindings/clock/nordic,nrf-hfxo64m.yaml
```yaml
# Copyright (c) 2025 Nordic Semiconductor ASA
# SPDX-License-Identifier: LicenseRef-Nordic-5-Clause

description: Nordic high-frequency crystal oscillator 64 MHz

compatible: "nordic,nrf-hfxo64m"

include: fixed-clock.yaml

properties:
  clock-frequency:
    const: 64000000

  accuracy-ppm:
    type: int
    description: Clock accuracy in parts per million
    required: true
```

## soc/nordic/Kconfig
```kconfig
# Nordic Semiconductor nRFx MCU line

# Copyright (c) 2016-2018 Nordic Semiconductor ASA
# SPDX-License-Identifier: Apache-2.0

# This file is contains Zephyr build system Kconfig references and is not
# re-usable outside the Zephyr tree.

config SOC_FAMILY_NORDIC_NRF
	select SOC_COMPATIBLE_NRF
	select SOC_RESET_HOOK if ARM

if SOC_FAMILY_NORDIC_NRF

rsource "*/Kconfig"
source "$ZEPHYR_BASE/soc/nordic/Kconfig"

endif # SOC_FAMILY_NORDIC_NRF
```

## soc/nordic/Kconfig.soc
```kconfig
# Copyright (c) 2022 Nordic Semiconductor ASA

# SPDX-License-Identifier: Apache-2.0

config SOC_SERIES
	default "nrf71" if SOC_SERIES_NRF71X

config SOC_FAMILY_NORDIC_NRF
	bool

config SOC_FAMILY
	default "nordic_nrf" if SOC_FAMILY_NORDIC_NRF

config SOC_SERIES_NRF71X
	bool
	select SOC_FAMILY_NORDIC_NRF
	help
	  Nordic Semiconductor nRF71 series MCU

rsource "*/Kconfig.soc"
```

## soc/nordic/nrf71/Kconfig
```kconfig
# Nordic Semiconductor nRF71 MCU line

# Copyright (c) 2025 Nordic Semiconductor ASA
# SPDX-License-Identifier: LicenseRef-Nordic-5-Clause

config SOC_SERIES_NRF71X
	select HAS_NRFX
	select HAS_NORDIC_DRIVERS
	select HAS_SEGGER_RTT if ZEPHYR_SEGGER_MODULE
	select SOC_EARLY_INIT_HOOK
	select SOC_RESET_HOOK
	select NRF_PLATFORM_LUMOS

config SOC_NRF7120_ENGA_CPUAPP
	select ARM
	select ARMV8_M_DSP
	select CPU_CORTEX_M33
	select CPU_HAS_ARM_MPU
	select CPU_HAS_ICACHE
	select CPU_HAS_ARM_SAU
	select CPU_HAS_FPU
	select HAS_HW_NRF_RADIO_IEEE802154
	select HAS_POWEROFF
	select HAS_SWO

config SOC_NRF7120_ENGA_CPUFLPR
	select RISCV_CORE_NORDIC_VPR

if SOC_SERIES_NRF71X

DT_MPC_REGION_SIZE := $(dt_nodelabel_path,nrf_mpc_region)

config NRF_TRUSTZONE_FLASH_REGION_SIZE
	hex
	default $(dt_node_int_prop_hex,$(DT_MPC_REGION_SIZE),override-granularity)
	help
	  This defines the flash region size from the TRUSTZONE perspective.
	  It is used when configuring the TRUSTZONE and when setting alignments
	  requirements for the partitions.
	  This abstraction allows us to configure TRUSTZONE without depending
	  on peripheral specific symbols.

config NRF_TRUSTZONE_RAM_REGION_SIZE
	hex
	default $(dt_node_int_prop_hex,$(DT_MPC_REGION_SIZE),override-granularity)
	help
	  This defines the RAM region size from the TRUSTZONE perspective.
	  It is used when configuring the TRUSTZONE and when setting alignments
	  requirements for the partitions.
	  This abstraction allows us to configure TRUSTZONE without depending
	  on peripheral specific symbols.

config VBAT_MONITOR_ENABLE
	bool "Enable VBAT monitoring"
	default y
	select NRFX_SAADC
	select ADC
	help
	  Enable periodic VBAT voltage monitoring using SAADC.
	  When enabled, the application will periodically measure
	  the battery voltage and trigger a callback if it falls
	  below the configured threshold.

if VBAT_MONITOR_ENABLE

config VBAT_MONITOR_INTERVAL_MS
	int "VBAT measurement interval (milliseconds)"
	default 5000
	range 100 3600000
	help
	  Interval between VBAT measurements in milliseconds.
	  Minimum: 100 ms
	  Maximum: 3600000 ms (1 hour)

config VBAT_MONITOR_LOWER_THRESHOLD_MV
	int "VBAT low threshold (millivolts)"
	default 250
	range 200 5000
	help
	  Battery voltage threshold in millivolts. When the measured
	  voltage falls below this value, the low battery callback
	  will be triggered.
	  Typical range: 2000-5000 mV

config VBAT_MONITOR_LOG_LEVEL
	int "VBAT monitor log level"
	default 3
	range 0 4
	help
	  Log level for VBAT monitor module:
	  0 = OFF
	  1 = ERROR
	  2 = WARN
	  3 = INFO
	  4 = DEBUG

endif # VBAT_MONITOR_ENABLE


endif # SOC_SERIES_NRF71X
```

## soc/nordic/nrf71/Kconfig.defconfig.nrf7120_enga_cpuapp
```kconfig
# Nordic Semiconductor nRF7120 MCU

# Copyright (c) 2024 Nordic Semiconductor ASA
# SPDX-License-Identifier: Apache-2.0

if SOC_NRF7120_ENGA_CPUAPP
#TODO: Verify this number
config NUM_IRQS
	default 271

endif # SOC_NRF7120_ENGA_CPUAPP
```

## soc/nordic/nrf71/Kconfig.defconfig.nrf7120_enga_cpuflpr
```kconfig
# Nordic Semiconductor nRF7120 MCU

# Copyright (c) 2024 Nordic Semiconductor ASA
# SPDX-License-Identifier: Apache-2.0

if SOC_NRF7120_ENGA_CPUFLPR
#TODO: Verify this number
config NUM_IRQS
	default 287

endif # SOC_NRF7120_ENGA_CPUFLPR
```

## soc/nordic/nrf71/Kconfig.soc
```kconfig
# Nordic Semiconductor nRF71 MCU line

# Copyright (c) 2025 Nordic Semiconductor ASA
# SPDX-License-Identifier: LicenseRef-Nordic-5-Clause

config SOC_NRF7120_PREENG
	bool
	select SOC_NRF7120
	help
	  NRF7120 PRE-ENG
```

## tests/drivers/uart/uart_baudrate_test/Kconfig
```kconfig
#
# Copyright (c) 2025 Nordic Semiconductor ASA
#
# SPDX-License-Identifier: LicenseRef-Nordic-5-Clause
#

source "Kconfig.zephyr"

config ALLOWED_DEVIATION
	int "Allowed deviation (%) for UART timing checks"
	default 25
	range 0 100
	help
	  Maximum allowed deviation (%) from the programmed values for the test to be
	  considered a PASS. For example, if set to 5, the measured period of bit
	  can deviate by up to 5% from the programmed values for the test to pass.

config UART_BAUDRATE_MULTIPLIER
    int "Multiplier for HF Peripheral"
    default 1
    help
      Some DUTs (e.g. UARTE00 on FPGA) require baudrate scaling because the FPGA
      clock frequencies are not the same as in real silicon.
	    
		- The HF clock is scaled down to 20 MHz (instead of 256 MHz).
		- The "16 MHz" peripheral clock is instead derived as HF/4 = 5 MHz.
		- UARTE00 therefore runs from 20 MHz, while other UARTEs run from 5 MHz.
		- This gives a scale factor of 4 between UARTE00 and the other UARTEs
		(instead of 16 as in real hardware).
		
```

## tests/zephyr/drivers/clock_control/clock_control_api/testcase.yaml
```yaml
common:
  tags:
    - drivers
    - clock_control
    - ci_tests_zephyr_drivers_clock_control
tests:
  nrf.extended.drivers.clock.clock_control_nrf5.7120:
    platform_allow:
      - nrf7120pdk/nrf7120/cpuapp/emu
  nrf.extended.drivers.clock.clock_control_nrf5_lfclk_rc.7120:
    platform_allow:
      - nrf7120pdk/nrf7120/cpuapp/emu
    extra_args: CONF_FILE="nrf_lfclk_rc.conf"
```

## tests/zephyr/drivers/clock_control/nrf_clock_calibration/testcase.yaml
```yaml
tests:
  nrf.extended.drivers.clock.nrf5_clock_calibration.7120:
    tags:
      - drivers
      - clock_control
      - ci_tests_zephyr_drivers_clock_control
    platform_allow:
      - nrf7120pdk/nrf7120/cpuapp/emu
```

## tests/zephyr/drivers/clock_control/nrf_lf_clock_start/testcase.yaml
```yaml
common:
  tags:
    - drivers
    - clock_control
    - ci_tests_zephyr_drivers_clock_control
tests:
  nrf.extended.drivers.clock.nrf_lf_clock_start_xtal_stable.7120:
    platform_allow:
      - nrf7120pdk/nrf7120/cpuapp/emu
    extra_configs:
      - CONFIG_SYSTEM_CLOCK_WAIT_FOR_STABILITY=y
      - CONFIG_CLOCK_CONTROL_NRF_K32SRC_XTAL=y

  nrf.extended.drivers.clock.nrf_lf_clock_start_xtal_available.7120:
    platform_allow:
      - nrf7120pdk/nrf7120/cpuapp/emu
    extra_configs:
      - CONFIG_SYSTEM_CLOCK_WAIT_FOR_AVAILABILITY=y
      - CONFIG_CLOCK_CONTROL_NRF_K32SRC_XTAL=y

  nrf.extended.drivers.clock.nrf_lf_clock_start_xtal_no_wait.7120:
    platform_allow:
      - nrf7120pdk/nrf7120/cpuapp/emu
    extra_configs:
      - CONFIG_SYSTEM_CLOCK_NO_WAIT=y
      - CONFIG_CLOCK_CONTROL_NRF_K32SRC_XTAL=y

  nrf.extended.drivers.clock.nrf_lf_clock_start_rc_stable.7120:
    platform_allow:
      - nrf7120pdk/nrf7120/cpuapp/emu
    extra_configs:
      - CONFIG_SYSTEM_CLOCK_WAIT_FOR_STABILITY=y
      - CONFIG_CLOCK_CONTROL_NRF_K32SRC_RC=y

  nrf.extended.drivers.clock.nrf_lf_clock_start_rc_available.7120:
    platform_allow:
      - nrf7120pdk/nrf7120/cpuapp/emu
    extra_configs:
      - CONFIG_SYSTEM_CLOCK_WAIT_FOR_AVAILABILITY=y
      - CONFIG_CLOCK_CONTROL_NRF_K32SRC_RC=y

  nrf.extended.drivers.clock.nrf_lf_clock_start_rc_no_wait.7120:
    platform_allow:
      - nrf7120pdk/nrf7120/cpuapp/emu
    extra_configs:
      - CONFIG_SYSTEM_CLOCK_NO_WAIT=y
      - CONFIG_CLOCK_CONTROL_NRF_K32SRC_RC=y

  nrf.extended.drivers.clock.nrf_lf_clock_start_synth_stable.7120:
    platform_allow:
      - nrf7120pdk/nrf7120/cpuapp/emu
    extra_configs:
      - CONFIG_SYSTEM_CLOCK_WAIT_FOR_STABILITY=y
      - CONFIG_CLOCK_CONTROL_NRF_K32SRC_SYNTH=y

  nrf.extended.drivers.clock.nrf_lf_clock_start_synth_available.7120:
    platform_allow:
      - nrf7120pdk/nrf7120/cpuapp/emu
    extra_configs:
      - CONFIG_SYSTEM_CLOCK_WAIT_FOR_AVAILABILITY=y
      - CONFIG_CLOCK_CONTROL_NRF_K32SRC_SYNTH=y

  nrf.extended.drivers.clock.nrf_lf_clock_start_synth_no_wait.7120:
    platform_allow:
      - nrf7120pdk/nrf7120/cpuapp/emu
    extra_configs:
      - CONFIG_SYSTEM_CLOCK_NO_WAIT=y
      - CONFIG_CLOCK_CONTROL_NRF_K32SRC_SYNTH=y
```

## tests/zephyr/drivers/clock_control/onoff/testcase.yaml
```yaml
tests:
  nrf.extended.drivers.clock.clock_control_onoff.7120:
    tags:
      - drivers
      - clock_control
      - ci_tests_drivers_clock_control
    platform_allow:
      - nrf7120pdk/nrf7120/cpuapp/emu
```

## tests/zephyr/drivers/gpio/gpio_basic_api/testcase.yaml
```yaml
common:
  tags:
    - drivers
    - gpio
    - ci_tests_zephyr_drivers_gpio
  depends_on: gpio
  harness: ztest
  harness_config:
    fixture: gpio_loopback

tests:
  nrf.extended.drivers.gpio.2pin:
    min_flash: 34
    filter: dt_compat_enabled("test-gpio-basic-api") and not dt_compat_enabled("arduino-header-r3")
```

## tests/zephyr/drivers/sensor/temp_sensor/testcase.yaml
```yaml
tests:
  nrf.extended.drivers.sensor.temp_sensor:
    tags:
      - drivers
      - sensors
    filter: dt_nodelabel_enabled("temp_sensor")
    integration_platforms:
      - nrf7120pdk/nrf7120/cpuapp
```

## tests/zephyr/drivers/timer/nrf_grtc_timer/testcase.yaml
```yaml
tests:
  nrf.extended.drivers.timer.nrf_grtc_timer:
    tags:
      - drivers
      - ci_tests_zephyr_drivers_timer
    platform_allow:
      - nrf54l09pdk/nrf54l09/cpuflpr
      - nrf54l20pdk/nrf54l20/cpuflpr
      - nrf7120pdk/nrf7120/cpuapp
    integration_platforms:
      - nrf54l20pdk/nrf54l20/cpuflpr
```

## tests/zephyr/drivers/uart/uart_async_api/testcase.yaml
```yaml
common:
  platform_exclude:
    - stamp_c3
    - wio_terminal
    - xiao_esp32c3
  tags:
    - drivers
    - uart
tests:
  nrf.extended.drivers.uart.async_api.nrf_uarte_new:
    platform_allow:
      - nrf7120pdk/nrf7120/cpuapp
    filter: CONFIG_SERIAL_SUPPORT_ASYNC
    harness: ztest
    harness_config:
      fixture: gpio_loopback
    depends_on: gpio
    extra_configs:
      - CONFIG_UART_NRFX_UARTE_LEGACY_SHIM=n
  nrf.extended.drivers.uart.async_api.rtt:
    filter: CONFIG_SERIAL_SUPPORT_ASYNC and CONFIG_HAS_SEGGER_RTT
      and not CONFIG_UART_MCUX_LPUART and not CONFIG_UART_MCUX_FLEXCOMM
    extra_args: DTC_OVERLAY_FILE=${ZEPHYR_BASE}/tests/drivers/uart/uart_async_api/boards/segger_rtt.overlay
    extra_configs:
      - CONFIG_USE_SEGGER_RTT=y
      - CONFIG_UART_RTT=y
    platform_exclude:
      - xmc45_relax_kit
      - xmc47_relax_kit
    build_only: true
    integration_platforms:
      - qemu_cortex_m0
```
