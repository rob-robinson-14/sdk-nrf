/*
 * Copyright (c) 2024 Nordic Semiconductor ASA
 *
 * SPDX-License-Identifier: Apache-2.0
 */

/dts-v1/;

#define USE_NON_SECURE_ADDRESS_MAP 1

#include "nrf7120_enga_cpuapp_common.dtsi"

/ {
	compatible = "nordic,nrf7120pdk_nrf7120_enga-cpuapp";
	model = "Nordic nRF7120 PDK nRF7120_ENGA Application MCU";

	chosen {
		zephyr,sram = &cpuapp_sram;
	};
};

&uart30 {
	/* Disable so that TF-M can use this UART */
	status = "disabled";

	current-speed = <115200>;
	pinctrl-0 = <&uart30_default>;
	pinctrl-1 = <&uart30_sleep>;
	pinctrl-names = "default", "sleep";
};
