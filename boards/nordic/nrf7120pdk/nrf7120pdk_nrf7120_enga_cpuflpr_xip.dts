/*
 * Copyright (c) 2024 Nordic Semiconductor ASA
 *
 * SPDX-License-Identifier: Apache-2.0
 */

#include "nrf7120pdk_nrf7120_enga_cpuflpr.dts"

&cpuflpr_sram {
	reg = <0x200e0000 DT_SIZE_K(124)>;
	ranges = <0x0 0x200e0000 0x1f000>;
};
