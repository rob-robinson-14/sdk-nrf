## samples/benchmarks/power_consumption/Kconfig
```kconfig
#
# Copyright (c) 2026 Nordic Semiconductor ASA
#
# SPDX-License-Identifier: LicenseRef-Nordic-5-Clause
#

mainmenu "nRF7120 System ON Idle power consumption benchmark"

config SAMPLE_POWER_CONSUMPTION_IDLE_SECONDS
	int "System ON idle duration in seconds"
	range 1 3600
	default 10
	help
	  Duration of the sleep period (through k_sleep(), on this SoC's default
	  GRTC-backed system timer) before waking up, printing the wake
	  counter, and sleeping again.

config SAMPLE_POWER_CONSUMPTION_LATENCY_MEASUREMENT
	bool "Enable wake-up latency GPIO measurement"
	select NRFX_GPIOTE
	select NRFX_GPPI
	help
	  Use a dedicated GRTC compare channel as the wake-up source and expose
	  three GPIO timing markers. The event marker is driven directly from
	  the GRTC compare event through GPPI and GPIOTE. The interrupt marker
	  is set at the start of the GRTC callback, and the thread marker is set
	  after the sleeping thread resumes. The dedicated PDSELECT0 pin is
	  configured through SREGS30 to output PwrAboveElv, which is low while
	  the device is in ELV mode.

	  The marker GPIOs are defined by the sample's board overlay. This mode
	  adds measurement hardware and software overhead and is disabled by
	  default.

config SAMPLE_POWER_CONSUMPTION_CONSTLAT
	bool "Constant latency mode"
	depends on SAMPLE_POWER_CONSUMPTION_LATENCY_MEASUREMENT
	select NRF_SYS_EVENT
	select SOC_NRF_FORCE_CONSTLAT
	help
	  Force constant latency mode while measuring wake-up latency. This
	  minimizes and stabilizes CPU wake-up and PPI task response latency by
	  keeping base resources enabled during System ON Idle, at the cost of
	  increased power consumption.

	  Leave this disabled to measure the default low-power mode.

choice SAMPLE_POWER_CONSUMPTION_RAM_RETAIN
	prompt "RAM retention level during System ON Idle"
	default SAMPLE_POWER_CONSUMPTION_RAM_RETAIN_FULL
	help
	  Controls the amount of application RAM that remains powered during System ON
	  Idle, using the ram_pwrdn library (see
	  nrf/doc/nrf/libraries/others/ram_pwrdn.rst). Total amount of SRAM on
	  nrf7120dk/nrf7120/cpuapp is 1016 KiB, not 1024 KiB -- keep this in
	  mind when reading the option names below.

config SAMPLE_POWER_CONSUMPTION_RAM_RETAIN_64K
	bool "Retain only the first 64 KiB of application RAM, power down the rest"
	select RAM_POWER_DOWN_LIBRARY
	help
	  Calls power_down_ram() once at boot to power down everything past
	  the first 64 KiB of application RAM (out of 1016 KiB total).

config SAMPLE_POWER_CONSUMPTION_RAM_RETAIN_128K
	bool "Retain only the first 128 KiB of application RAM, power down the rest"
	select RAM_POWER_DOWN_LIBRARY
	help
	  Calls power_down_ram() once at boot to power down everything past
	  the first 128 KiB of application RAM (out of 1016 KiB total).

config SAMPLE_POWER_CONSUMPTION_RAM_RETAIN_256K
	bool "Retain only the first 256 KiB of application RAM, power down the rest"
	select RAM_POWER_DOWN_LIBRARY
	help
	  Calls power_down_ram() once at boot to power down everything past
	  the first 256 KiB of application RAM (out of 1016 KiB total).

config SAMPLE_POWER_CONSUMPTION_RAM_RETAIN_512K
	bool "Retain only the first 512 KiB of application RAM, power down the rest"
	select RAM_POWER_DOWN_LIBRARY
	help
	  Calls power_down_ram() once at boot to power down everything past
	  the first 512 KiB of application RAM (out of 1016 KiB total, so
	  this leaves slightly more than half of RAM powered down, not
	  exactly half).

config SAMPLE_POWER_CONSUMPTION_RAM_RETAIN_FULL
	bool "Retain all RAM (default) -- nothing is powered down"
	help
	  No RAM power-down call is made at all. This is the default: by
	  default, all RAM must stay retained.

config SAMPLE_POWER_CONSUMPTION_RAM_RETAIN_USED_ONLY
	bool "Retain only RAM used by this image (power down the rest)"
	select RAM_POWER_DOWN_LIBRARY
	help
	  Calls power_down_unused_ram() instead of a fixed KiB boundary.
	  Everything from _image_ram_end through the end of application RAM is
	  powered down; runtime heap in that range can bus fault (see ram_pwrdn
	  docs).

endchoice

source "Kconfig.zephyr"
```
